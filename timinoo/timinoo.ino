#include "U8glib.h"

U8GLIB_SH1106_128X64 u8g(13, 11, 10, 9); // SCK = 13, MOSI = 11, CS = 10, A0 = 9
/*
= OLED screen =

GND  = GND (5V)
VCC  = 5V
CLK  = 13
MOSI = 11
RES  = RES
DC   = 9
CS   = 10

= Button =

GND = GND (3V)
VCC = 3V
SIG = 2
*/

int gameMode = 0;
const char* textToDisplay = "";
const int buttonPin = 2;
int buttonState = 0;
unsigned long frameCounter = 0;
char frameCounterString[7];
char animationStepString[1];
long randomNumber;
int catX = 0;
int catY = 0;
int animationStep = 1;
int animationStepMax = 4;
const byte ButtonPin = 2;
const unsigned long DebounceTime = 10;
boolean ButtonWasPressed = false;
unsigned long ButtonStateChangeTime = 0; // Debounce timer
int currentIcon = 0;
int cuddleCounter = 0;
int cleanCounter = 0;
int cleanLoopCounter = 0;
int gameCounter = 0;
int gameSequence = 0;
long gamePick = 0;
int strawberryFoodStock = 0;
int appleFoodStock = 10000;
int iceCreamFoodStock = 1;
int grapeFoodStock = 0;
int milkFoodStock = 0;
int orangeFoodStock = 0;
int lessonSequence = 0;
int snailCounter = 0;
int kokoXPos = 0;
long randomQuote = 0;
int feedSequence = 0;
int feedCounter = 0;
int selectedFood = 0;

// Cat status variables
// Status metrics
// 0 = depleted, 1 = low, 2 = average, 3 = full
long catHunger = random(1, 3);
long catHygiene = random(1, 3);
long catMorale = random(1, 3);
long catEducation = random(1, 3);
long catEntertainment = random(1, 3);

// Status change timing (decrement status variable every x frames)
// Production timings
unsigned long catHungerStep = random(7500, 8500);
unsigned long catHygieneStep = random(15000, 20000);
unsigned long catMoraleStep = random(4000, 5000);
unsigned long catEducationStep = random(800, 1600);
unsigned long catEntertainmentStep = random(250, 500);

// Tracking status checks
unsigned long lastCatHungerCheck = 0;
unsigned long lastCatHygieneCheck = 0;
unsigned long lastCatMoraleCheck = 0;
unsigned long lastCatEducationCheck = 0;
unsigned long lastCatEntertainmentCheck = 0;

#define koko_le_snail_26x22_width 26
#define koko_le_snail_26x22_height 22
static unsigned char koko_le_snail_26x22_bits[] U8G_PROGMEM = {
   0x3c, 0xf0, 0x00, 0x00, 0x3c, 0xf0, 0x00, 0x00, 0xff, 0xfc, 0x03, 0x00,
   0xff, 0xfc, 0x03, 0x00, 0xcf, 0xcc, 0x03, 0x00, 0xcf, 0xcc, 0x03, 0x00,
   0x3c, 0xf3, 0x00, 0x00, 0x3c, 0xf3, 0x00, 0x00, 0xc0, 0x0f, 0xfc, 0x00,
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   0xc0, 0xff, 0xff, 0x00 };

#define orange_28x28_width 28
#define orange_28x28_height 28
static unsigned char orange_28x28_bits[] U8G_PROGMEM = {
   0x00, 0x00, 0x00, 0x00, 0x00, 0x00, 0x00, 0x00, 0x00, 0x00, 0x00, 0x00,
   0x3c, 0x00, 0xc0, 0x03, 0x3c, 0x00, 0xc0, 0x03, 0xcf, 0x03, 0xf0, 0x0c,
   0xcf, 0x03, 0xf0, 0x0c, 0xcf, 0xff, 0xff, 0x0c, 0xcf, 0xff, 0xff, 0x0c,
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   0x00, 0x00, 0x00, 0x00 };

#define milk_28x28_width 28
#define milk_28x28_height 28
static unsigned char milk_28x28_bits[] U8G_PROGMEM = {
   0x00, 0x00, 0x00, 0x00, 0x00, 0x00, 0x00, 0x00, 0x00, 0x00, 0x00, 0x00,
   0x00, 0x78, 0x01, 0x00, 0x00, 0xfc, 0x02, 0x00, 0x00, 0xfc, 0x02, 0x00,
   0x00, 0x00, 0x00, 0x00, 0x00, 0xfe, 0x06, 0x00, 0x00, 0x7f, 0x0f, 0x00,
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   0xc0, 0xdf, 0x3f, 0x00 };

#define grape_28x28_width 28
#define grape_28x28_height 28
static unsigned char grape_28x28_bits[] U8G_PROGMEM = {
   0x00, 0x0c, 0x00, 0x00, 0x00, 0x0c, 0x00, 0x00, 0x00, 0x30, 0x00, 0x00,
   0x00, 0x30, 0x00, 0x00, 0x00, 0x00, 0x00, 0x00, 0x00, 0x00, 0x00, 0x00,
   0x3c, 0xfc, 0xc0, 0x03, 0x3c, 0xfc, 0xc0, 0x03, 0x33, 0xcf, 0x33, 0x0f,
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   0x00, 0xf0, 0x00, 0x00 };

#define strawberry_28x28_width 28
#define strawberry_28x28_height 28
static unsigned char strawberry_28x28_bits[] U8G_PROGMEM = {
   0x00, 0x00, 0x00, 0x00, 0x00, 0x00, 0x00, 0x00, 0xc0, 0xf3, 0x3c, 0x00,
   0xc0, 0xf3, 0x3c, 0x00, 0xc0, 0x0f, 0x3f, 0x00, 0xc0, 0x0f, 0x3f, 0x00,
   0x00, 0xf0, 0x00, 0x00, 0x00, 0xf0, 0x00, 0x00, 0xf0, 0xfc, 0xf3, 0x00,
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   0x00, 0x00, 0x00, 0x00 };

#define apple_28x28_width 28
#define apple_28x28_height 28
static unsigned char apple_28x28_bits[] U8G_PROGMEM = {
   0xf8, 0x07, 0x00, 0x00, 0xf8, 0x07, 0x00, 0x00, 0xf8, 0x1f, 0x00, 0x00,
   0xf8, 0x1f, 0x00, 0x00, 0xe0, 0x67, 0x00, 0x00, 0xe0, 0x67, 0x00, 0x00,
   0x00, 0x60, 0x7e, 0x00, 0x00, 0x60, 0x7e, 0x00, 0xf8, 0x61, 0xf8, 0x01,
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   0x80, 0xff, 0x1f, 0x00 };

#define bar_28x28_width 28
#define bar_28x28_height 28
static unsigned char bar_28x28_bits[] U8G_PROGMEM = {
   0x00, 0x00, 0x00, 0x00, 0xfc, 0xff, 0xff, 0x03, 0xfc, 0xff, 0xff, 0x03,
   0x03, 0x00, 0x00, 0x0c, 0xff, 0xff, 0xff, 0x0f, 0xff, 0xff, 0xff, 0x0f,
   0x00, 0x00, 0x00, 0x00, 0x00, 0x00, 0x00, 0x00, 0x7c, 0xf0, 0xf8, 0x00,
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   0x00, 0x00, 0x00, 0x00 };

#define casino_frame_40x40_width 40
#define casino_frame_40x40_height 40
static unsigned char casino_frame_40x40_bits[] U8G_PROGMEM = {
   0xf8, 0xff, 0xff, 0xff, 0x1f, 0xf8, 0xff, 0xff, 0xff, 0x1f, 0xf8, 0xff,
   0xff, 0xff, 0x1f, 0xff, 0xff, 0xff, 0xff, 0xff, 0xff, 0xff, 0xff, 0xff,
   0xff, 0x1f, 0x00, 0x00, 0x00, 0xf8, 0x1f, 0x00, 0x00, 0x00, 0xf8, 0x1f,
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   0xff, 0xff, 0x1f, 0xf8, 0xff, 0xff, 0xff, 0x1f };

#define comframev4_width 128
#define comframev4_height 64
static unsigned char comframev4_bits[] U8G_PROGMEM = {
   0x00, 0x00, 0x00, 0x00, 0x00, 0x00, 0x00, 0x00, 0x00, 0x00, 0x00, 0x00,
   0x00, 0x00, 0x00, 0x00, 0x00, 0x00, 0x00, 0x00, 0x00, 0x00, 0x00, 0x00,
   0x00, 0x00, 0x00, 0x00, 0x00, 0x00, 0x00, 0x00, 0x00, 0x00, 0x00, 0x00,
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   0x00, 0x00, 0x00, 0x00 };

#define happy_cat_28x28_width 28
#define happy_cat_28x28_height 28
static unsigned char happy_cat_28x28_bits[] U8G_PROGMEM = {
   0xc0, 0xff, 0x3f, 0x00, 0xc0, 0xff, 0x3f, 0x00, 0xf0, 0xff, 0xff, 0x00,
   0xf0, 0xff, 0xff, 0x00, 0xfc, 0xff, 0xff, 0x03, 0xfc, 0xff, 0xff, 0x03,
   0xff, 0xff, 0xff, 0x0f, 0xff, 0xff, 0xff, 0x0f, 0xff, 0xfc, 0xf3, 0x0f,
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   0xc0, 0xff, 0x3f, 0x00 };

#define ghost_28x28_width 28
#define ghost_28x28_height 28
static unsigned char ghost_28x28_bits[] U8G_PROGMEM = {
   0x00, 0xfc, 0x3f, 0x00, 0x00, 0xfc, 0x3f, 0x00, 0x00, 0xff, 0xff, 0x00,
   0x00, 0xff, 0xff, 0x00, 0xc0, 0xff, 0xff, 0x03, 0xc0, 0xff, 0xff, 0x03,
   0xc0, 0x0f, 0x0f, 0x03, 0xc0, 0x0f, 0x0f, 0x03, 0xf0, 0x0f, 0x0f, 0x0f,
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   0x00, 0x0f, 0x0f, 0x00 };

#define play_32x20_width 32
#define play_32x20_height 20
static unsigned char play_32x20_bits[] U8G_PROGMEM = {
   0x30, 0xff, 0xff, 0x0f, 0x30, 0xff, 0xff, 0x0f, 0xcc, 0xff, 0xff, 0x3f,
   0xcc, 0xff, 0xff, 0x3f, 0xf3, 0xff, 0xff, 0xff, 0xf3, 0xff, 0xff, 0xff,
   0xf3, 0xf3, 0x3f, 0xf3, 0xf3, 0xf3, 0x3f, 0xf3, 0xf3, 0xc0, 0xff, 0xff,
   0xf3, 0xc0, 0xff, 0xff, 0xf3, 0xf3, 0x30, 0xf3, 0xf3, 0xf3, 0x30, 0xf3,
   0xf3, 0xff, 0xff, 0xff, 0xf3, 0xff, 0xff, 0xff, 0xf3, 0xff, 0xff, 0xff,
   0xf3, 0xff, 0xff, 0xff, 0xcc, 0xff, 0xf3, 0x3f, 0xcc, 0xff, 0xf3, 0x3f,
   0x30, 0x3f, 0xcc, 0x0f, 0x30, 0x3f, 0xcc, 0x0f };

#define study_26x28_width 26
#define study_26x28_height 28
static unsigned char study_26x28_bits[] U8G_PROGMEM = {
   0xfc, 0xff, 0xff, 0x03, 0xfc, 0xff, 0xff, 0x03, 0x3f, 0xff, 0xf3, 0x03,
   0x3f, 0xff, 0xf3, 0x03, 0xcf, 0xff, 0xcf, 0x03, 0xcf, 0xff, 0xcf, 0x03,
   0xcf, 0x03, 0xcf, 0x03, 0xcf, 0x03, 0xcf, 0x03, 0xcf, 0xff, 0xcf, 0x03,
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   0xfc, 0xff, 0xff, 0x03 };

#define cuddle_24x24_width 24
#define cuddle_24x24_height 24
static unsigned char cuddle_24x24_bits[] U8G_PROGMEM = {
   0xf0, 0x00, 0x0f, 0xf0, 0x00, 0x0f, 0xfc, 0xc3, 0x3f, 0xfc, 0xc3, 0x3f,
   0xff, 0xff, 0xff, 0xff, 0xff, 0xff, 0xff, 0xff, 0xff, 0xff, 0xff, 0xff,
   0x3f, 0x3c, 0xfc, 0x3f, 0x3c, 0xfc, 0x0f, 0x00, 0xf0, 0x0f, 0x00, 0xf0,
   0x0f, 0x00, 0xf0, 0x0f, 0x00, 0xf0, 0x3c, 0x00, 0x3c, 0x3c, 0x00, 0x3c,
   0xf0, 0x00, 0x0f, 0xf0, 0x00, 0x0f, 0xc0, 0xc3, 0x03, 0xc0, 0xc3, 0x03,
   0x00, 0xff, 0x00, 0x00, 0xff, 0x00, 0x00, 0x3c, 0x00, 0x00, 0x3c, 0x00 };

#define bubbles_30x30_width 30
#define bubbles_30x30_height 30
static unsigned char bubbles_30x30_bits[] U8G_PROGMEM = {
   0xf0, 0x0f, 0x00, 0x00, 0xf0, 0x0f, 0x00, 0x00, 0x0c, 0x30, 0x00, 0x00,
   0x0c, 0x30, 0x00, 0x00, 0xf3, 0xc0, 0x00, 0x00, 0xf3, 0xc0, 0x00, 0x00,
   0xf3, 0xc0, 0x00, 0x00, 0xf3, 0xc0, 0x00, 0x00, 0x03, 0xcc, 0x00, 0x00,
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   0x30, 0x30, 0x00, 0x00, 0xc0, 0x0f, 0x00, 0x00, 0xc0, 0x0f, 0x00, 0x00 };

#define pizza_26x28_width 26
#define pizza_26x28_height 28
static unsigned char pizza_26x28_bits[] U8G_PROGMEM = {
   0xf0, 0xff, 0x3f, 0x00, 0xf0, 0xff, 0x3f, 0x00, 0xfc, 0xff, 0xff, 0x00,
   0xfc, 0xff, 0xff, 0x00, 0x3f, 0x00, 0xf0, 0x03, 0x3f, 0x00, 0xf0, 0x03,
   0xcf, 0xf3, 0xcc, 0x03, 0xcf, 0xf3, 0xcc, 0x03, 0xf0, 0x3f, 0x30, 0x00,
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   0x00, 0x0c, 0x00, 0x00 };

#define cat_sitting_upscaled4x_001_width 48
#define cat_sitting_upscaled4x_001_height 48
static unsigned char cat_sitting_upscaled4x_001_bits[] U8G_PROGMEM = {
   0x00, 0x00, 0xf0, 0x0f, 0x00, 0xff, 0x00, 0x00, 0xf0, 0x0f, 0x00, 0xff,
   0x00, 0x00, 0xf0, 0x0f, 0x00, 0xff, 0x00, 0x00, 0xf0, 0x0f, 0x00, 0xff,
   0x00, 0x00, 0xf0, 0xf0, 0xff, 0xf0, 0x00, 0x00, 0xf0, 0xf0, 0xff, 0xf0,
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   0xff, 0xff, 0xff, 0xff, 0xff, 0xff, 0xff, 0xff, 0xff, 0xff, 0xff, 0xff };

#define cat_sitting_upscaled4x_002_width 48
#define cat_sitting_upscaled4x_002_height 48
static unsigned char cat_sitting_upscaled4x_002_bits[] U8G_PROGMEM = {
   0x00, 0x00, 0xf0, 0x0f, 0x00, 0xff, 0x00, 0x00, 0xf0, 0x0f, 0x00, 0xff,
   0x00, 0x00, 0xf0, 0x0f, 0x00, 0xff, 0x00, 0x00, 0xf0, 0x0f, 0x00, 0xff,
   0x00, 0x00, 0xf0, 0xf0, 0xff, 0xf0, 0x00, 0x00, 0xf0, 0xf0, 0xff, 0xf0,
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   0xff, 0xf0, 0xff, 0xff, 0xff, 0xff, 0xff, 0xf0, 0xff, 0xff, 0xff, 0xff };

#define cat_sitting_upscaled4x_003_width 48
#define cat_sitting_upscaled4x_003_height 48
static unsigned char cat_sitting_upscaled4x_003_bits[] U8G_PROGMEM = {
   0x00, 0x00, 0xf0, 0x0f, 0x00, 0xff, 0x00, 0x00, 0xf0, 0x0f, 0x00, 0xff,
   0x00, 0x00, 0xf0, 0x0f, 0x00, 0xff, 0x00, 0x00, 0xf0, 0x0f, 0x00, 0xff,
   0x00, 0x00, 0xf0, 0xf0, 0xff, 0xf0, 0x00, 0x00, 0xf0, 0xf0, 0xff, 0xf0,
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   0x00, 0xf0, 0xff, 0xff, 0xff, 0xff, 0x00, 0xf0, 0xff, 0xff, 0xff, 0xff };

#define cat_sitting_upscaled4x_004_width 48
#define cat_sitting_upscaled4x_004_height 48
static unsigned char cat_sitting_upscaled4x_004_bits[] U8G_PROGMEM = {
   0x00, 0x00, 0xf0, 0x0f, 0x00, 0xff, 0x00, 0x00, 0xf0, 0x0f, 0x00, 0xff,
   0x00, 0x00, 0xf0, 0x0f, 0x00, 0xff, 0x00, 0x00, 0xf0, 0x0f, 0x00, 0xff,
   0x00, 0x00, 0xf0, 0xf0, 0xff, 0xf0, 0x00, 0x00, 0xf0, 0xf0, 0xff, 0xf0,
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   0x00, 0xff, 0xff, 0xff, 0xff, 0xff, 0x00, 0xff, 0xff, 0xff, 0xff, 0xff };

#define cat_sitting_upscaled4x_006_width 48
#define cat_sitting_upscaled4x_006_height 48
static unsigned char cat_sitting_upscaled4x_006_bits[] U8G_PROGMEM = {
   0x00, 0x00, 0x00, 0xff, 0x00, 0xff, 0x00, 0x00, 0x00, 0xff, 0x00, 0xff,
   0x00, 0x00, 0x00, 0xff, 0x00, 0xff, 0x00, 0x00, 0x00, 0xff, 0x00, 0xff,
   0x00, 0x00, 0x00, 0x0f, 0xff, 0xf0, 0x00, 0x00, 0x00, 0x0f, 0xff, 0xf0,
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   0xff, 0xf0, 0xff, 0xff, 0xff, 0xff, 0xff, 0xf0, 0xff, 0xff, 0xff, 0xff };

#define cat_sitting_upscaled4x_007_width 48
#define cat_sitting_upscaled4x_007_height 48
static unsigned char cat_sitting_upscaled4x_007_bits[] U8G_PROGMEM = {
   0x00, 0x00, 0x00, 0xff, 0x00, 0xff, 0x00, 0x00, 0x00, 0xff, 0x00, 0xff,
   0x00, 0x00, 0x00, 0xff, 0x00, 0xff, 0x00, 0x00, 0x00, 0xff, 0x00, 0xff,
   0x00, 0x00, 0x00, 0x0f, 0xff, 0xf0, 0x00, 0x00, 0x00, 0x0f, 0xff, 0xf0,
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   0x00, 0xf0, 0xff, 0xff, 0xff, 0xff, 0x00, 0xf0, 0xff, 0xff, 0xff, 0xff };

#define cat_licking_upscaled4x_001_width 52
#define cat_licking_upscaled4x_001_height 48
static unsigned char cat_licking_upscaled4x_001_bits[] U8G_PROGMEM = {
   0x00, 0x00, 0xf0, 0x0f, 0x00, 0xff, 0x00, 0x00, 0x00, 0xf0, 0x0f, 0x00,
   0xff, 0x00, 0x00, 0x00, 0xf0, 0x0f, 0x00, 0xff, 0x00, 0x00, 0x00, 0xf0,
   0x0f, 0x00, 0xff, 0x00, 0x00, 0x00, 0xf0, 0xf0, 0xff, 0xf0, 0x00, 0x00,
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   0xff, 0xff, 0xff, 0x00, 0x00, 0xff, 0xff, 0xff, 0xff, 0xff, 0x00, 0x00 };

#define cat_licking_upscaled4x_002_width 52
#define cat_licking_upscaled4x_002_height 44
static unsigned char cat_licking_upscaled4x_002_bits[] U8G_PROGMEM = {
   0x00, 0x00, 0xf0, 0x0f, 0x00, 0xff, 0x00, 0x00, 0x00, 0xf0, 0x0f, 0x00,
   0xff, 0x00, 0x00, 0x00, 0xf0, 0x0f, 0x00, 0xff, 0x00, 0x00, 0x00, 0xf0,
   0x0f, 0x00, 0xff, 0x00, 0x00, 0x00, 0xf0, 0xf0, 0xff, 0xf0, 0x00, 0x00,
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   0x00, 0xff, 0xff, 0xff, 0xff, 0xff, 0x00, 0x00 };

#define cat_licking_upscaled4x_003_width 52
#define cat_licking_upscaled4x_003_height 44
static unsigned char cat_licking_upscaled4x_003_bits[] U8G_PROGMEM = {
   0x00, 0x00, 0xff, 0x00, 0xff, 0x00, 0x00, 0x00, 0x00, 0xff, 0x00, 0xff,
   0x00, 0x00, 0x00, 0x00, 0xff, 0x00, 0xff, 0x00, 0x00, 0x00, 0x00, 0xff,
   0x00, 0xff, 0x00, 0x00, 0x00, 0x00, 0x0f, 0xff, 0xff, 0x0f, 0x00, 0x00,
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   0x00, 0xff, 0xff, 0xff, 0xff, 0xff, 0x00, 0x00 };

#define cat_licking_upscaled4x_004_width 52
#define cat_licking_upscaled4x_004_height 48
static unsigned char cat_licking_upscaled4x_004_bits[] U8G_PROGMEM = {
   0x00, 0x00, 0xff, 0x00, 0xff, 0x00, 0x00, 0x00, 0x00, 0xff, 0x00, 0xff,
   0x00, 0x00, 0x00, 0x00, 0xff, 0x00, 0xff, 0x00, 0x00, 0x00, 0x00, 0xff,
   0x00, 0xff, 0x00, 0x00, 0x00, 0x00, 0x0f, 0xff, 0xff, 0x0f, 0x00, 0x00,
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   0xff, 0xff, 0xff, 0x00, 0x00, 0xff, 0xff, 0xff, 0xff, 0xff, 0x00, 0x00 };

#define cat_licking_upscaled4x_005_width 52
#define cat_licking_upscaled4x_005_height 48
static unsigned char cat_licking_upscaled4x_005_bits[] U8G_PROGMEM = {
   0x00, 0x00, 0xf0, 0x0f, 0x00, 0xff, 0x00, 0x00, 0x00, 0xf0, 0x0f, 0x00,
   0xff, 0x00, 0x00, 0x00, 0xf0, 0x0f, 0x00, 0xff, 0x00, 0x00, 0x00, 0xf0,
   0x0f, 0x00, 0xff, 0x00, 0x00, 0x00, 0xf0, 0xf0, 0xff, 0xf0, 0x00, 0x00,
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   0xff, 0xff, 0xff, 0x00, 0x00, 0xff, 0xff, 0xff, 0xff, 0xff, 0x00, 0x00 };

#define cat_licking_upscaled4x_006_width 52
#define cat_licking_upscaled4x_006_height 44
static unsigned char cat_licking_upscaled4x_006_bits[] U8G_PROGMEM = {
   0x00, 0x00, 0xf0, 0x0f, 0x00, 0x00, 0x00, 0x00, 0x00, 0xf0, 0x0f, 0x00,
   0x00, 0x00, 0x00, 0x00, 0xf0, 0x0f, 0x00, 0x00, 0x00, 0x00, 0x00, 0xf0,
   0x0f, 0x00, 0x00, 0x00, 0x00, 0x00, 0xf0, 0xf0, 0xff, 0xff, 0x00, 0x00,
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   0x00, 0xff, 0xff, 0xff, 0xff, 0xff, 0x00, 0x00 };

#define cat_licking_upscaled4x_007_width 52
#define cat_licking_upscaled4x_007_height 44
static unsigned char cat_licking_upscaled4x_007_bits[] U8G_PROGMEM = {
   0x00, 0x00, 0xf0, 0x0f, 0x00, 0x00, 0x00, 0x00, 0x00, 0xf0, 0x0f, 0x00,
   0x00, 0x00, 0x00, 0x00, 0xf0, 0x0f, 0x00, 0x00, 0x00, 0x00, 0x00, 0xf0,
   0x0f, 0x00, 0x00, 0x00, 0x00, 0x00, 0xf0, 0xf0, 0xff, 0x00, 0x00, 0x00,
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   0x00, 0xff, 0xff, 0xff, 0xff, 0xff, 0x00, 0x00 };

#define cat_licking_upscaled4x_008_width 52
#define cat_licking_upscaled4x_008_height 48
static unsigned char cat_licking_upscaled4x_008_bits[] U8G_PROGMEM = {
   0x00, 0x00, 0xf0, 0x0f, 0x00, 0x00, 0x00, 0x00, 0x00, 0xf0, 0x0f, 0x00,
   0x00, 0x00, 0x00, 0x00, 0xf0, 0x0f, 0x00, 0x00, 0x00, 0x00, 0x00, 0xf0,
   0x0f, 0x00, 0x00, 0x00, 0x00, 0x00, 0xf0, 0xf0, 0xff, 0xff, 0x0f, 0x00,
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   0xff, 0xff, 0xff, 0x00, 0x00, 0xff, 0xff, 0xff, 0xff, 0xff, 0x00, 0x00 };

#define cuddle_heart_11x10_width 11
#define cuddle_heart_11x10_height 10
static unsigned char cuddle_heart_11x10_bits[] U8G_PROGMEM = {
   0x8c, 0x01, 0xde, 0x03, 0xff, 0x07, 0xff, 0x07, 0xff, 0x07, 0xfe, 0x03,
   0xfc, 0x01, 0xf8, 0x00, 0x70, 0x00, 0x20, 0x00 };

void checkButton()
{
  unsigned long currentTime = millis();
  boolean buttonIsPressed = digitalRead(ButtonPin) == HIGH;  // Active HIGH


  // Check for button state change and do debounce
  if (buttonIsPressed != ButtonWasPressed &&
      currentTime  -  ButtonStateChangeTime > DebounceTime)
  {
    // Button state has changed
    ButtonWasPressed = buttonIsPressed;
    ButtonStateChangeTime = currentTime;


    if (ButtonWasPressed)
    {
      // Button was just pressed
    }
    else
    {
      // Button was just released
      if (gameMode == 1) {
        // Do something only if cat needs something
        switch (currentIcon) {
          case 2:
            // Play
            gameCounter = 0;
            gameSequence = 0;
            gameMode = 6;
            break;
          case 3:
            // Study
            randomQuote = random(1, 6);
            kokoXPos = 128;
            snailCounter = 0;
            lessonSequence = 0;
            gameMode = 4;
            break;
          case 4:
            // Cuddle
            cuddleCounter = 0;
            gameMode = 3;
            break;
          case 5:
            // Clean
            cleanCounter=0;
            cleanLoopCounter=0;
            gameMode = 5;
            break;
          case 6:
            // Feed
            selectedFood = 0;
            feedSequence = 0;
            feedCounter = 0;
            gameMode = 2;
            break;
        }
      } else if (gameMode == 6) {
        // Game
        gamePick = random (0, 7);
        gameSequence = 1;
        gameCounter = 0;
      }
    }
  }


  if (ButtonWasPressed)
  {
    // Button is being held down
  }
}

void setup(void) {
  // initialize the pushbutton pin as an input:
  pinMode(buttonPin, INPUT);
  // flip screen, if required
  u8g.setRot180();
}

void loop(void) {
  randomNumber = random(1, 10);
  checkButton();
  frameCounter += 1;
  ltoa(frameCounter, frameCounterString, 10);
  animationStep += 1;
  if (animationStep>animationStepMax) {
    animationStep=1;
  }
  ltoa(animationStep, animationStepString, 10);

  // Refresh cat statistics
  // Hunger
  if (frameCounter == lastCatHungerCheck + catHungerStep) {
    catHunger -= 1;
    if (catHunger < 0) {
      catHunger = 0;
    }
    lastCatHungerCheck = frameCounter;
  }
  // Hygiene
  if (frameCounter == lastCatHygieneCheck + catHygieneStep) {
    catHygiene -= 1;
    if (catHygiene < 0) {
      catHygiene = 0;
    }
    lastCatHygieneCheck = frameCounter;
  }
  // Morale
  if (frameCounter == lastCatMoraleCheck + catMoraleStep) {
    catMorale -= 1;
    if (catMorale < 0) {
      catMorale = 0;
    }
    lastCatMoraleCheck = frameCounter;
  }
  // Education
  if (frameCounter == lastCatEducationCheck + catEducationStep) {
    if (catEducation < 3 && gameMode == 0) {
      // Time to study
      currentIcon = 3;
      gameMode = 1;
    }
    lastCatEducationCheck = frameCounter;
  }
  // Entertainment
  if (frameCounter == lastCatEntertainmentCheck + catEntertainmentStep) {
    catEntertainment -= 1;
    if (catEntertainment < 0) {
      catEntertainment = 0;
    }
    lastCatEntertainmentCheck = frameCounter;
  }

  // Act on cat stats
  if (catHunger == 0 && gameMode == 0) {
    // Time to feed the cat
    currentIcon = 6;
    gameMode = 1;
  } else if (catHygiene==0 && gameMode == 0) {
    // Time to clean
    currentIcon = 5;
    gameMode = 1;
  } else if (catMorale==0 && gameMode == 0) {
    // Time to cuddle
    currentIcon = 4;
    gameMode = 1;
  } else if (catEntertainment==0 && gameMode == 0) {
    // Time to play
    currentIcon = 2;
    gameMode = 1;
  }
  
  u8g.firstPage();
  do {
    switch (gameMode) {
      case 0:
        // Idling
        animationStepMax = 4;
        checkButton();
        // Icon frame
        u8g.drawXBMP(0, 0, comframev4_width, comframev4_height, comframev4_bits);
        // Icon (always happy)
        u8g.drawXBMP(87, 12, happy_cat_28x28_width, happy_cat_28x28_height, happy_cat_28x28_bits);
        switch (animationStep) {
          case 1:
            checkButton();
            catX = 8;
            catY = 8;
            u8g.drawXBMP(catX, catY, cat_sitting_upscaled4x_001_width, cat_sitting_upscaled4x_001_height, cat_sitting_upscaled4x_001_bits);
            break;
          case 2:
            checkButton();
            catX = 8;
            catY = 8;
            u8g.drawXBMP(catX, catY, cat_sitting_upscaled4x_002_width, cat_sitting_upscaled4x_002_height, cat_sitting_upscaled4x_002_bits);
            break;
          case 3:
            checkButton();
            catX = 8;
            catY = 8;
            u8g.drawXBMP(catX, catY, cat_sitting_upscaled4x_003_width, cat_sitting_upscaled4x_003_height, cat_sitting_upscaled4x_003_bits);
            break;
          case 4:
            checkButton();
            catX = 8;
            catY = 8;
            u8g.drawXBMP(catX, catY, cat_sitting_upscaled4x_004_width, cat_sitting_upscaled4x_004_height, cat_sitting_upscaled4x_004_bits);
            break;
        }
        break;
      case 1:
        // Idle - looking left
        animationStepMax = 4;
        checkButton();
        // Icon frame
        u8g.drawXBMP(0, 0, comframev4_width, comframev4_height, comframev4_bits);
        // Icon (anything else than happy)
        switch (currentIcon) {
          case 0:
            // Happy
            u8g.drawXBMP(87, 12, happy_cat_28x28_width, happy_cat_28x28_height, happy_cat_28x28_bits);
            break;
          case 1:
            // Ghost
            u8g.drawXBMP(87, 12, ghost_28x28_width, ghost_28x28_height, ghost_28x28_bits);
            break;
          case 2:
            // Play
            u8g.drawXBMP(85, 16, play_32x20_width, play_32x20_height, play_32x20_bits);
            break;
          case 3:
            // Study
            u8g.drawXBMP(88, 12, study_26x28_width, study_26x28_height, study_26x28_bits);
            break;
          case 4:
            // Cuddle
            u8g.drawXBMP(89, 14, cuddle_24x24_width, cuddle_24x24_height, cuddle_24x24_bits);
            break;
          case 5:
            // Bubbles
            u8g.drawXBMP(86, 11, bubbles_30x30_width, bubbles_30x30_height, bubbles_30x30_bits);
            break;
          case 6:
            // Pizza
            u8g.drawXBMP(88, 12, pizza_26x28_width, pizza_26x28_height, pizza_26x28_bits);
            break;
        }
        switch (animationStep) {
          case 1:
            checkButton();
            catX = 8;
            catY = 8;
            u8g.drawXBMP(catX, catY, cat_sitting_upscaled4x_001_width, cat_sitting_upscaled4x_001_height, cat_sitting_upscaled4x_001_bits);
            break;
          case 2:
            checkButton();
            catX = 8;
            catY = 8;
            u8g.drawXBMP(catX, catY, cat_sitting_upscaled4x_006_width, cat_sitting_upscaled4x_006_height, cat_sitting_upscaled4x_006_bits);
            break;
          case 3:
            checkButton();
            catX = 8;
            catY = 8;
            u8g.drawXBMP(catX, catY, cat_sitting_upscaled4x_007_width, cat_sitting_upscaled4x_007_height, cat_sitting_upscaled4x_007_bits);
            break;
          case 4:
            checkButton();
            catX = 8;
            catY = 8;
            u8g.drawXBMP(catX, catY, cat_sitting_upscaled4x_004_width, cat_sitting_upscaled4x_004_height, cat_sitting_upscaled4x_004_bits);
            break;
        }
        break;
      case 2:
        // Feed
        u8g.setFont(u8g_font_unifont);
        switch (feedSequence) {
          case 0:
            // Select food
            if (strawberryFoodStock > 0) {
              selectedFood = 1;
              strawberryFoodStock -= 1;
            } else if (grapeFoodStock > 0) {
              selectedFood = 2;
              grapeFoodStock -= 1;
            } else if (milkFoodStock > 0) {
              selectedFood = 3;
              milkFoodStock -= 1;
            } else if (orangeFoodStock > 0) {
              selectedFood = 4;
              orangeFoodStock -= 1;
            } else if (appleFoodStock > 0) {
              selectedFood = 5;
              appleFoodStock -= 1;
            } else {
              selectedFood = 6;
            }
            feedSequence = 1;
            break;
          case 1:
            // Eat food
            switch (selectedFood) {
              case 1:
                u8g.drawXBMP(50, 14, strawberry_28x28_width, strawberry_28x28_height, strawberry_28x28_bits);
                // u8g.drawStr(14, 58, "Yummy strawberry");
                break;
              case 2:
                u8g.drawXBMP(50, 14, grape_28x28_width, grape_28x28_height, grape_28x28_bits);
                // u8g.drawStr(14, 58, "Fresh grapes");
                break;
              case 3:
                u8g.drawXBMP(50, 14, milk_28x28_width, milk_28x28_height, milk_28x28_bits);
                // u8g.drawStr(14, 58, "Farm milk");
                break;
              case 4:
                u8g.drawXBMP(50, 14, orange_28x28_width, orange_28x28_height, orange_28x28_bits);
                // u8g.drawStr(14, 58, "Juicy orange");
                break;
              case 5:
                u8g.drawXBMP(50, 14, apple_28x28_width, apple_28x28_height, apple_28x28_bits);
                // u8g.drawStr(14, 58, "Tasty apple");
                break;
              case 6:
                u8g.drawXBMP(50, 14, ghost_28x28_width, ghost_28x28_height, ghost_28x28_bits);
                u8g.drawStr(14, 58, "No food");
                break;
            }
            feedCounter += 1;
            if (feedCounter>300) {
              feedCounter = 0;
              feedSequence = 2;
            }
            break;
          case 2:
            // Yum
            u8g.drawXBMP(-24, 13, cat_sitting_upscaled4x_001_width, cat_sitting_upscaled4x_001_height, cat_sitting_upscaled4x_001_bits);
            if (selectedFood != 7) {
              u8g.drawStr(30, 30, "Yum!");
            }
            feedCounter += 1;
            if (feedCounter>300) {
              feedCounter = 0;
              if (selectedFood != 7) {
                catHunger = 3;
              }
              gameMode = 0;
            }
            break;
        }
        break;
      case 3:
        // Cuddle
        catX = 8;
        catY = 8;
        u8g.drawXBMP(catX, catY, cat_sitting_upscaled4x_001_width, cat_sitting_upscaled4x_001_height, cat_sitting_upscaled4x_001_bits);
        cuddleCounter += 1;
        if (cuddleCounter<31) {
          u8g.drawXBMP(80, 45 - cuddleCounter, cuddle_heart_11x10_width, cuddle_heart_11x10_height, cuddle_heart_11x10_bits);
          u8g.drawXBMP(92, 40 - cuddleCounter, cuddle_heart_11x10_width, cuddle_heart_11x10_height, cuddle_heart_11x10_bits);
          u8g.drawXBMP(104, 45 - cuddleCounter, cuddle_heart_11x10_width, cuddle_heart_11x10_height, cuddle_heart_11x10_bits);
        } else if (cuddleCounter>30 && cuddleCounter < 161) {
          u8g.drawXBMP(80, 15, cuddle_heart_11x10_width, cuddle_heart_11x10_height, cuddle_heart_11x10_bits);
          u8g.drawXBMP(92, 10, cuddle_heart_11x10_width, cuddle_heart_11x10_height, cuddle_heart_11x10_bits);
          u8g.drawXBMP(104, 15, cuddle_heart_11x10_width, cuddle_heart_11x10_height, cuddle_heart_11x10_bits);
          u8g.setFont(u8g_font_u8glib_4);
          u8g.drawStr(70, 40, "I love you too <3");
        } else if (cuddleCounter>160 && cuddleCounter < 240) {
          u8g.setFont(u8g_font_u8glib_4);
          u8g.drawStr(70, 40, "I love you too <3");
        } else if (cuddleCounter==240) {
          catMorale = 3;
          gameMode = 0;
        }
        break;
      case 4:
        // Educate
        switch (lessonSequence) {
          case 0:
            // Snail arrives
            u8g.drawXBMP(-24, 13, cat_sitting_upscaled4x_001_width, cat_sitting_upscaled4x_001_height, cat_sitting_upscaled4x_001_bits);
            u8g.drawXBMP(kokoXPos, 40, koko_le_snail_26x22_width, koko_le_snail_26x22_height, koko_le_snail_26x22_bits);
            kokoXPos -= 1;
            if (kokoXPos < 97) {
              kokoXPos = 97;
            }
            snailCounter += 1;
            if (snailCounter>100) {
              snailCounter = 0;
              lessonSequence = 1;
            }
            break;
          case 1:
            // Snail says hello
            u8g.setFont(u8g_font_u8glib_4);
            u8g.drawXBMP(-24, 13, cat_sitting_upscaled4x_001_width, cat_sitting_upscaled4x_001_height, cat_sitting_upscaled4x_001_bits);
            u8g.drawXBMP(97, 40, koko_le_snail_26x22_width, koko_le_snail_26x22_height, koko_le_snail_26x22_bits);
            u8g.drawStr(54, 16, "   -= *** =-   ");
            u8g.drawStr(54, 22, "Welcome to a");
            u8g.drawStr(54, 28, "new lesson with");
            u8g.drawStr(54, 34, "Koko Le Snail");
            snailCounter += 1;
            if (snailCounter>300) {
              snailCounter = 0;
              lessonSequence = 2;
            }
            break;
          case 2:
            // Snail wisdom quote
            u8g.setFont(u8g_font_u8glib_4);
            u8g.drawXBMP(-24, 13, cat_sitting_upscaled4x_001_width, cat_sitting_upscaled4x_001_height, cat_sitting_upscaled4x_001_bits);
            u8g.drawXBMP(97, 40, koko_le_snail_26x22_width, koko_le_snail_26x22_height, koko_le_snail_26x22_bits);
            switch (randomQuote) {
              case 1:
                u8g.drawStr(54, 16, "Sometimes dogs");
                u8g.drawStr(54, 22, "are grey.");
                u8g.drawStr(54, 28, "");
                u8g.drawStr(54, 34, "  -- Koko");
                break;
              case 2:
                u8g.drawStr(54, 16, "Do not sneeze");
                u8g.drawStr(54, 22, "on the bus.");
                u8g.drawStr(54, 28, "");
                u8g.drawStr(54, 34, "  -- Koko");
                break;
              case 3:
                u8g.drawStr(54, 16, "Always wear");
                u8g.drawStr(54, 22, "pants.");
                u8g.drawStr(54, 28, "");
                u8g.drawStr(54, 34, "  -- Koko");
                break;
              case 4:
                u8g.drawStr(54, 16, "Never yawn");
                u8g.drawStr(54, 22, "during class.");
                u8g.drawStr(54, 28, "");
                u8g.drawStr(54, 34, "  -- Koko");
                break;
              case 5:
                u8g.drawStr(54, 16, "Wash your hands");
                u8g.drawStr(54, 22, "after lunch.");
                u8g.drawStr(54, 28, "");
                u8g.drawStr(54, 34, "  -- Koko");
                break;
              case 6:
                u8g.drawStr(54, 16, "Pull my finger...");
                u8g.drawStr(54, 22, "teehee!");
                u8g.drawStr(54, 28, "");
                u8g.drawStr(54, 34, "  -- Koko");
                break;
            }
            snailCounter += 1;
            if (snailCounter>300) {
              snailCounter = 0;
              lessonSequence = 3;
            }
            break;
          case 3:
            // Score
            u8g.setFont(u8g_font_unifont);
            u8g.drawXBMP(51, 14, study_26x28_width, study_26x28_height, study_26x28_bits);
            u8g.drawStr(10, 58, "+ 1 Education");
            snailCounter += 1;
            if (snailCounter>300) {
              snailCounter = 0;
              catEducation += 1;
              gameMode = 0;
            }
            break;
        }
        break;
      case 5:
        // Clean
        animationStepMax = 8;
        switch (animationStep) {
          case 1:
            u8g.drawXBMP(38, 8, cat_licking_upscaled4x_001_width, cat_licking_upscaled4x_001_height, cat_licking_upscaled4x_001_bits);
            break;
          case 2:
            u8g.drawXBMP(38, 12, cat_licking_upscaled4x_002_width, cat_licking_upscaled4x_002_height, cat_licking_upscaled4x_002_bits);
            break;
          case 3:
            u8g.drawXBMP(38, 12, cat_licking_upscaled4x_003_width, cat_licking_upscaled4x_003_height, cat_licking_upscaled4x_003_bits);
            break;
          case 4:
            u8g.drawXBMP(38, 8, cat_licking_upscaled4x_004_width, cat_licking_upscaled4x_004_height, cat_licking_upscaled4x_004_bits);
            break;
          case 5:
            u8g.drawXBMP(38, 8, cat_licking_upscaled4x_005_width, cat_licking_upscaled4x_005_height, cat_licking_upscaled4x_005_bits);
            break;
          case 6:
            u8g.drawXBMP(38, 12, cat_licking_upscaled4x_006_width, cat_licking_upscaled4x_006_height, cat_licking_upscaled4x_006_bits);
            break;
          case 7:
            u8g.drawXBMP(38, 12, cat_licking_upscaled4x_007_width, cat_licking_upscaled4x_007_height, cat_licking_upscaled4x_007_bits);
            break;
          case 8:
            u8g.drawXBMP(38, 8, cat_licking_upscaled4x_008_width, cat_licking_upscaled4x_008_height, cat_licking_upscaled4x_008_bits);
            cleanCounter += 1;
            if (cleanCounter>40) {
              cleanCounter = 0;
              catHygiene = 3;
              gameMode = 0;
            }
            break;
        }
        u8g.setFont(u8g_font_u8glib_4);
        u8g.drawStr(38, 62, "Scrub scrub <3");
        break;
      case 6:
        // Play
        if (gameSequence == 0) {
          // Roll the dice
          animationStepMax = 7;
          u8g.drawXBMP(0, 10, casino_frame_40x40_width, casino_frame_40x40_height, casino_frame_40x40_bits);
          u8g.drawXBMP(41, 10, casino_frame_40x40_width, casino_frame_40x40_height, casino_frame_40x40_bits);
          u8g.drawXBMP(82, 10, casino_frame_40x40_width, casino_frame_40x40_height, casino_frame_40x40_bits);
          switch (animationStep) {
            case 1:
              checkButton();
              u8g.drawXBMP(6, 16, ghost_28x28_width, ghost_28x28_height, ghost_28x28_bits);
              break;
            case 2:
              checkButton();
              u8g.drawXBMP(47, 16, bar_28x28_width, bar_28x28_height, bar_28x28_bits);
              break;
            case 3:
              checkButton();
              u8g.drawXBMP(88, 16, strawberry_28x28_width, strawberry_28x28_height, strawberry_28x28_bits);
              break;
            case 4:
              checkButton();
              u8g.drawXBMP(6, 16, apple_28x28_width, apple_28x28_height, apple_28x28_bits);
              break;
            case 5:
              checkButton();
              u8g.drawXBMP(88, 16, grape_28x28_width, grape_28x28_height, grape_28x28_bits);
              break;
            case 6:
              checkButton();
              u8g.drawXBMP(6, 16, milk_28x28_width, milk_28x28_height, milk_28x28_bits);
              break;
            case 7:
              checkButton();
              u8g.drawXBMP(47, 16, orange_28x28_width, orange_28x28_height, orange_28x28_bits);
              gameCounter += 1;
              if (gameCounter>300) {
                gameCounter = 0;
                gameMode = 0;
              }
              break;
          }
        } else if (gameSequence == 1) {
          // See the result
          u8g.setFont(u8g_font_unifont);
          switch (gamePick) {
            case 0:
              // Ghost
              u8g.drawXBMP(50, 14, ghost_28x28_width, ghost_28x28_height, ghost_28x28_bits);
              u8g.drawStr(14, 58, "Nothing, boo!");
              break;
            case 1:
              // Bar
              u8g.drawXBMP(50, 14, bar_28x28_width, bar_28x28_height, bar_28x28_bits);
              u8g.drawStr(14, 58, "+ 1 of all!");
              strawberryFoodStock += 1;
              appleFoodStock += 1;
              grapeFoodStock += 1;
              milkFoodStock += 1;
              orangeFoodStock += 1;
              break;
            case 2:
              // Strawberry
              u8g.drawXBMP(50, 14, strawberry_28x28_width, strawberry_28x28_height, strawberry_28x28_bits);
              u8g.drawStr(14, 58, "+ 1 strawberry");
              strawberryFoodStock += 1;
              break;
            case 3:
              // Apple
              u8g.drawXBMP(50, 14, apple_28x28_width, apple_28x28_height, apple_28x28_bits);
              u8g.drawStr(14, 58, "+ 1 apple");
              appleFoodStock += 1;
              break;
            case 4:
              // Grape
              u8g.drawXBMP(50, 14, grape_28x28_width, grape_28x28_height, grape_28x28_bits);
              u8g.drawStr(14, 58, "+ 1 grape");
              grapeFoodStock += 1;
              break;
            case 5:
              // Milk
              u8g.drawXBMP(50, 14, milk_28x28_width, milk_28x28_height, milk_28x28_bits);
              u8g.drawStr(14, 58, "+ 1 milk");
              milkFoodStock += 1;
              break;
            case 6:
              // Orange
              u8g.drawXBMP(50, 14, orange_28x28_width, orange_28x28_height, orange_28x28_bits);
              u8g.drawStr(14, 58, "+ 1 orange");
              orangeFoodStock += 1;
              break;
          }
          gameCounter += 1;
          if (gameCounter>400) {
            gameCounter = 0;
            catEntertainment = 3;
            gameMode = 0;
          }
        }
        break;
    }
    /*
    // Frame counter
    u8g.setFont(u8g_font_unifont);
    u8g.drawStr(8, 50, frameCounterString);
    u8g.drawStr(8, 10, animationStepString);
    */
  } while( u8g.nextPage() );
}
